## board/freescale/ls1046accx/Kconfig
```kconfig
if TARGET_LS1046ACCX

config SYS_BOARD
	default "ls1046accx"

config SYS_VENDOR
	default "freescale"

config SYS_SOC
	default "fsl-layerscape"

config SYS_CONFIG_NAME
	default "ls1046accx"

if FSL_LS_PPA
config SYS_LS_PPA_FW_ADDR
	hex "PPA Firmware Addr"
	default 0x40400000 if SYS_LS_PPA_FW_IN_XIP && QSPI_BOOT
	default 0x400000 if SYS_LS_PPA_FW_IN_MMC || SYS_LS_PPA_FW_IN_NAND

choice SYSTEMX_LOADER
	prompt "SystemX Loader Srcipt"
	default SYSTEMX_LOADER_BOOT
	config SYSTEMX_LOADER_BOOT
		bool "Normal Boot"
	config SYSTEMX_LOADER_FUSES
		bool "Fuses burned in ATF"
	config SYSTEMX_LOADER_LOAD
		bool "Load SystemX from Media"
	config SYSTEMX_LOADER_NONE
		bool "Don't boot a kernel"
endchoice

if CHAIN_OF_TRUST
config SYS_LS_PPA_ESBC_ADDR
	hex "PPA Firmware HDR Addr"
	default 0x40680000 if SYS_LS_PPA_FW_IN_XIP && QSPI_BOOT
	default 0x680000 if SYS_LS_PPA_FW_IN_MMC || SYS_LS_PPA_FW_IN_NAND
endif
endif

source "board/freescale/common/Kconfig"
endif
```
